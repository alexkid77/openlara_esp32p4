## main/Kconfig.projbuild
```kconfig
menu "OpenLara controls"

    config OPENLARA_TOUCH_CONTROL
        bool "Enable touchscreen game controls"
        default n
        help
            Poll the board touch controller and use OpenLara's on-screen
            movement, camera, and action controls. USB keyboard input remains
            available regardless of this setting.

endmenu
```

## sdkconfig.defaults.esp32p4
```kconfig
CONFIG_IDF_TARGET="esp32p4"
CONFIG_IDF_TARGET_ESP32P4=y

# Early revision ESP32-P4-Function-EV-Board.
CONFIG_ESP32P4_SELECTS_REV_LESS_V3=y
CONFIG_ESP32P4_REV_MIN_1=y

CONFIG_SPIRAM_MODE_HEX=y
CONFIG_SPIRAM_SPEED_200M=y
CONFIG_SPIRAM_ALLOW_BSS_SEG_EXTERNAL_MEMORY=y
CONFIG_ESP_DEFAULT_CPU_FREQ_MHZ_360=y
CONFIG_ESP_DEFAULT_CPU_FREQ_MHZ=360
```

## sdkconfig.defaults.esp32s31
```kconfig
CONFIG_IDF_TARGET="esp32s31"
CONFIG_IDF_TARGET_ESP32S31=y
CONFIG_IDF_EXPERIMENTAL_FEATURES=y

# ESP32-S31-Korvo-1 board settings from esp-board-manager.
CONFIG_ESPTOOLPY_FLASHMODE_QIO=y
CONFIG_ESPTOOLPY_FLASHFREQ_80M=y
CONFIG_SPIRAM_MODE_OCT=y
CONFIG_SPIRAM_SPEED_200M=y
CONFIG_FREERTOS_TASK_CREATE_ALLOW_EXT_MEM=y
CONFIG_ESP_DEFAULT_CPU_FREQ_MHZ_320=y
CONFIG_ESP_DEFAULT_CPU_FREQ_MHZ=320
```
